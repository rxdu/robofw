## boards/arm/bbb_racer_cape/Kconfig.board
```kconfig
# Beaglebone Racer Cape configuration

# Copyright (c) 2021 Ruixiang Du
# SPDX-License-Identifier: Apache-2.0

config BOARD_BBB_RACER_CAPE
	bool "Beaglebone Black Racer Cape"
	depends on SOC_STM32F427XX
```

## boards/arm/bbb_racer_cape/Kconfig.defconfig
```kconfig
# Beaglebone Racer Cape configuration

# Copyright (c) 2021 Ruixiang Du
# SPDX-License-Identifier: Apache-2.0

if BOARD_BBB_RACER_CAPE

config BOARD
	default "bbb_racer_cape"

endif # BOARD_BB_RACER_CAPE
```

## boards/arm/bbb_racer_cape/bbb_racer_cape_defconfig
```kconfig
# SPDX-License-Identifier: Apache-2.0

# SOC
CONFIG_SOC_SERIES_STM32F4X=y
CONFIG_SOC_STM32F427XX=y

# Enable MPU
CONFIG_ARM_MPU=y

# Enable FPU
CONFIG_FPU=y

# Enable HW stack protection
CONFIG_HW_STACK_PROTECTION=y

# Console
CONFIG_CONSOLE=y
CONFIG_SERIAL=y
# CONFIG_UART_CONSOLE=y
CONFIG_USE_SEGGER_RTT=y
CONFIG_RTT_CONSOLE=y

CONFIG_PRINTK=y
CONFIG_CBPRINTF_FP_SUPPORT=y

# clock configuration
CONFIG_CLOCK_CONTROL=y

# Enable pinmux
CONFIG_PINMUX=y

# Enable GPIO
CONFIG_GPIO=y

# Enable PWM
CONFIG_PWM=y

# Enable CAN
CONFIG_CAN=y
CONFIG_CAN_STM32=y
CONFIG_CAN_MAX_FILTER=8

# Enable SPI
CONFIG_SPI=y
CONFIG_SPI_STM32_USE_HW_SS=n

# Enable IIS2MDC magnetometer sensor
CONFIG_SENSOR=y
CONFIG_IIS2MDC=y

# CONFIG_IIS2MDC_TRIGGER_OWN_THREAD=y
# CONFIG_IIS2MDC_TRIGGER_GLOBAL_THREAD=y
# CONFIG_IIS2MDC_TRIGGER_NONE=y
# CONFIG_IIS2MDC_TRIGGER_OWN_THREAD=y
# CONFIG_IIS2MDC_SPI_FULL_DUPLEX=n

CONFIG_ADC=y
CONFIG_STM32_TEMP=y
```

## boards/arm/periphf4_v1.4/Kconfig.board
```kconfig
# periphf4_v1.4 board configuration

# Copyright (c) 2021 Weston Robot

config BOARD_PERIPHF4_V1_4
	bool "Weston Robot Peripheral Board: periphf4_v1.4"
	depends on SOC_STM32F427XX
```

## boards/arm/periphf4_v1.4/Kconfig.defconfig
```kconfig
# periphf4_v1.4 board configuration

# Copyright (c) 2021 Weston Robot

if BOARD_PERIPHF4_V1_4

config BOARD
	default "periphf4_v1.4"

endif # BOARD_PERIPHF4_V1_4
```

## boards/arm/periphf4_v1.4/periphf4_v1.4_defconfig
```kconfig
# SPDX-License-Identifier: Apache-2.0

CONFIG_SOC_SERIES_STM32F4X=y
CONFIG_SOC_STM32F427XX=y

# Enable MPU
CONFIG_ARM_MPU=y

CONFIG_SERIAL=y

# Enable CAN
CONFIG_CAN=y
CONFIG_CAN_MAX_FILTER=8

# console
CONFIG_CONSOLE=y
CONFIG_UART_CONSOLE=y

# enable pinmux
CONFIG_PINMUX=y

# enable GPIO
CONFIG_GPIO=y

# clock configuration
CONFIG_CLOCK_CONTROL=y

# debugger
CONFIG_DEBUG_THREAD_INFO=y

# floating point support
CONFIG_FPU=y

# Enable PWM
CONFIG_PWM=y

# temperature sensor
# CONFIG_SENSOR=y
CONFIG_ADC=y
CONFIG_STM32_TEMP=y

# Enable I2C
# CONFIG_I2C=y
# Using I2C_GPIO
# CONFIG_I2C_GPIO=y
# external temperature sensor ADT7420
# CONFIG_ADT7420=y

## temporary disable 42605
# Enable SPI
# CONFIG_SPI=y
# CONFIG_ICM42605=y
# CONFIG_ICM42605_TRIGGER_OWN_THREAD=y
# CONFIG_SENSOR_LOG_LEVEL_DBG=y
# CONFIG_ICM42605_THREAD_STACK_SIZE=4096
```

## boards/arm/rcctrl_f405/Kconfig.board
```kconfig
# tbotctrl_f405 board configuration

# Copyright (c) 2022 Ruixiang Du (rdu)

config BOARD_RCCTRL_F405
	bool "RC Car Control Board: rcctrl_f405"
	depends on SOC_STM32F405XG
```

## boards/arm/rcctrl_f405/Kconfig.defconfig
```kconfig
# tbot_ctrl_f405rg board configuration

# Copyright (c) 2022 Ruixiang Du (rdu)

if BOARD_RCCTRL_F405

config BOARD
	default "rcctrl_f405"

endif # BOARD_RCCTRL_F405
```

## boards/arm/tbot_ctrl_f405rg/Kconfig.board
```kconfig
# tbot_ctrl_f405rg board configuration

# Copyright (c) 2022 Ruixiang Du (rdu)

config BOARD_TBOT_CTRL_F405RG
	bool "TBot Control Board: tbot_ctrl_f405rg"
	depends on SOC_STM32F405XG
```

## boards/arm/tbot_ctrl_f405rg/Kconfig.defconfig
```kconfig
# tbot_ctrl_f405rg board configuration

# Copyright (c) 2022 Ruixiang Du (rdu)

if BOARD_TBOT_CTRL_F405RG

config BOARD
	default "tbot_ctrl_f405rg"

endif # BOARD_TBOT_CTRL_F405RG
```

## boards/arm/tbot_ctrl_f405rg/tbot_ctrl_f405rg_defconfig
```kconfig
# SPDX-License-Identifier: Apache-2.0

CONFIG_SOC_SERIES_STM32F4X=y
CONFIG_SOC_STM32F405XG=y

# Enable MPU
CONFIG_ARM_MPU=y

CONFIG_SERIAL=y

# # Enable CAN
# CONFIG_CAN=y
# CONFIG_CAN_MAX_FILTER=8
# CONFIG_CAN_RX_TIMESTAMP=y

# console
CONFIG_CONSOLE=y
CONFIG_UART_CONSOLE=n
CONFIG_USE_SEGGER_RTT=y
CONFIG_RTT_CONSOLE=y

# enable pinmux
CONFIG_PINMUX=y

# enable GPIO
CONFIG_GPIO=y

# clock configuration
CONFIG_CLOCK_CONTROL=y

# debugger
# CONFIG_DEBUG_THREAD_INFO=y

# floating point support
CONFIG_FPU=y

# temperature sensor
# CONFIG_SENSOR=y
# CONFIG_ADC=y
# CONFIG_STM32_TEMP=y 
```

## boards/arm/tbotctrl_f405/Kconfig.board
```kconfig
# tbotctrl_f405 board configuration

# Copyright (c) 2022 Ruixiang Du (rdu)

config BOARD_TBOTCTRL_F405
	bool "TBot Control Board: tbotctrl_f405"
	depends on SOC_STM32F405XG
```

## boards/arm/tbotctrl_f405/Kconfig.defconfig
```kconfig
# tbot_ctrl_f405rg board configuration

# Copyright (c) 2022 Ruixiang Du (rdu)

if BOARD_TBOTCTRL_F405

config BOARD
	default "tbotctrl_f405"

endif # BOARD_TBOTCTRL_F405
```

## boards/arm/tbotctrl_f405/tbotctrl_f405_defconfig
```kconfig
# SPDX-License-Identifier: Apache-2.0

# Select SOC
CONFIG_SOC_SERIES_STM32F4X=y
CONFIG_SOC_STM32F405XG=y

# Enable RCC
CONFIG_CLOCK_CONTROL=y

# Enable FPU
CONFIG_FPU=y

# Enable MPU
CONFIG_ARM_MPU=y

# Enable RTOS Debugging
CONFIG_DEBUG_THREAD_INFO=y

# Enable Pinmux & GPIO
CONFIG_PINMUX=y
CONFIG_GPIO=y

# Enable CAN
CONFIG_CAN=y

# Enable UART
CONFIG_SERIAL=y
CONFIG_UART_ASYNC_API=y
CONFIG_RING_BUFFER=y

# Enable Console
#CONFIG_CONSOLE=y
#CONFIG_UART_CONSOLE=y
#CONFIG_USE_SEGGER_RTT=y
#CONFIG_RTT_CONSOLE=y

# Enable PWM
CONFIG_PWM=y

# Temperature sensor
CONFIG_SENSOR=y
CONFIG_ADC=y
CONFIG_STM32_TEMP=y
```

## boards/native_posix.conf
```kconfig
CONFIG_CAN=y
CONFIG_CAN_MAX_FILTER=5
CONFIG_CAN_NATIVE_POSIX_INTERFACE_1_NAME="can0"
CONFIG_CAN_NATIVE_POSIX_INTERFACE_2_NAME="vcan1"

CONFIG_SOC_POSIX=y
CONFIG_BOARD_NATIVE_POSIX_32BIT=y

# # CONFIG_UART_NATIVE_POSIX=y
# # CONFIG_NATIVE_UART_0_ON_OWN_PTY=y
# # CONFIG_NATIVE_UART_0_ON_STDINOUT=n
# # CONFIG_UART_NATIVE_POSIX_PORT_1_ENABLE=n
CONFIG_LOG_BACKEND_NATIVE_POSIX=y

CONFIG_NETWORKING=y
CONFIG_CAN_NATIVE_POSIX=y
CONFIG_ETH_NATIVE_POSIX=n
CONFIG_CAN_NATIVE_POSIX_INTERFACE_1=y
CONFIG_CAN_NATIVE_POSIX_INTERFACE_2=y

CONFIG_NET_SOCKETS=y
CONFIG_NET_SOCKETS_CAN=y
CONFIG_NET_SOCKETS_POSIX_NAMES=y

# CONFIG_CAN_NET=y
# CONFIG_NET_L2_CANBUS=y
CONFIG_NET_L2_CANBUS_RAW=y

CONFIG_NET_SOCKETS_CAN_RECEIVERS=4

# CONFIG_NET_IPV6=n
# CONFIG_NET_IPV4=n
# CONFIG_NET_MGMT=n
# CONFIG_NET_TCP=n
# CONFIG_NET_UDP=n

# CONFIG_NET_DEFAULT_IF_CANBUS_RAW=y

# CONFIG_NET_PKT_RX_COUNT=30
# CONFIG_NET_PKT_TX_COUNT=30
# CONFIG_NET_BUF_RX_COUNT=30
# CONFIG_NET_BUF_TX_COUNT=30

# CONFIG_TEST_RANDOM_GENERATOR=y

# CONFIG_NET_SHELL=y
# CONFIG_LOG=y
# CONFIG_NET_LOG=y
# CONFIG_LOG_IMMEDIATE=y

# CONFIG_NET_SOCKETS_LOG_LEVEL_DBG=y
# CONFIG_CAN_LOG_LEVEL_DBG=y
# #CONFIG_NET_CONTEXT_LOG_LEVEL_DBG=y
# #CONFIG_NET_CORE_LOG_LEVEL_DBG=y
# #CONFIG_NET_CONN_LOG_LEVEL_DBG=y

# # Use smaller buffers for net_buf as CANBUS packets are quite small.
# CONFIG_NET_BUF_DATA_SIZE=64
# CONFIG_NET_BUF_USER_DATA_SIZE=0
```

## drivers/Kconfig
```kconfig
# drivers configuration options

# Copyright (c) 2015 Intel Corporation
# SPDX-License-Identifier: Apache-2.0

menu "Device Drivers"

rsource "encoder/Kconfig"
# rsource "sensor/Kconfig"

endmenu
```

## drivers/encoder/Kconfig
```kconfig
# ENCODER configuration options

# Copyright (c) 2015 Intel Corporation
# SPDX-License-Identifier: Apache-2.0

menuconfig ENCODER
	bool "ENCODER (Pulse Width Modulation) Drivers"
	help
	  Enable config options for ENCODER drivers.

if ENCODER

module = ENCODER
module-str = encoder
source "subsys/logging/Kconfig.template.log_config"

# config PWM_SHELL
# 	bool "Enable ENCODER shell"
# 	default y
# 	depends on SHELL
# 	help
# 	  Enable the ENCODER related shell commands.

# config PWM_CAPTURE
# 	bool "Provide API for ENCODER capture"
# 	help
# 	  This option extends the Zephyr ENCODER API with the ability to capture ENCODER
# 	  period/pulse widths.

rsource "Kconfig.stm32"

endif # ENCODER
```

## drivers/encoder/Kconfig.stm32
```kconfig
# STM32 ENCODER configuration options

# Copyright (c) 2016 Linaro Limited.
# SPDX-License-Identifier: Apache-2.0

config ENCODER_STM32
	bool "STM32 MCU ENCODER driver"
	depends on SOC_FAMILY_STM32
	select USE_STM32_LL_TIM
	select USE_STM32_LL_RCC if SOC_SERIES_STM32F4X || SOC_SERIES_STM32F7X || SOC_SERIES_STM32H7X
	help
	  This option enables the ENCODER driver for STM32 family of
	  processors. Say y if you wish to use ENCODER port on STM32
	  MCU.
```

## drivers/sensor/Kconfig
```kconfig
# Copyright (c) 2021 Nordic Semiconductor ASA
# SPDX-License-Identifier: Apache-2.0

if SENSOR
rsource "iam20680/Kconfig"
endif # SENSOR
```

## drivers/sensor/iam20680/Kconfig
```kconfig
# IAM20680 Six-Axis Motion Tracking device configuration options

# Copyright (c) 2020 TDK Invensense
# SPDX-License-Identifier: Apache-2.0

menuconfig IAM20680
	bool "IAM20680 Six-Axis Motion Tracking Device"
	depends on SPI
	help
	  Enable driver for IAM20680 SPI-based six-axis motion tracking device.

if IAM20680

choice
	prompt "Trigger mode"
	default IAM20680_TRIGGER_GLOBAL_THREAD
	help
	  Specify the type of triggering to be used by the driver.

config IAM20680_TRIGGER_NONE
	bool "No trigger"

config IAM20680_TRIGGER_GLOBAL_THREAD
	bool "Use global thread"
	depends on GPIO
	select IAM20680_TRIGGER

config IAM20680_TRIGGER_OWN_THREAD
	bool "Use own thread"
	depends on GPIO
	select IAM20680_TRIGGER
endchoice

config IAM20680_TRIGGER
	bool

config IAM20680_THREAD_PRIORITY
	int "Thread priority"
	depends on IAM20680_TRIGGER_OWN_THREAD
	default 10
	help
	  Priority of thread used by the driver to handle interrupts.

config IAM20680_THREAD_STACK_SIZE
	int "Thread stack size"
	depends on IAM20680_TRIGGER_OWN_THREAD
	default 1024
	help
	  Stack size of thread used by the driver to handle interrupts.

endif # IAM20680
```

## dts/bindings/encoder/st,stm32-encoder.yaml
```yaml
description: STM32 ENCODER

compatible: "st,stm32-encoder"

include: [base.yaml]

properties:
    label:
      required: true

    st,encoder-mode:
      type: int
      required: true
      description: Encoder mode

    st,prescaler:
      type: int
      required: true
      description: Clock prescaler at the input of the timer

    pinctrl-0:
      type: phandles
      required: false
      description: |
        GPIO pin configuration for ENCODER signal/s. We expect that the phandles
        will reference pinctrl nodes, e.g.

           pinctrl-0 = <&tim1_ch1_pa8 &tim1_ch2_pa9>;
```

## west.yml
```yaml
# Copyright (c) 2021 Nordic Semiconductor ASA
# SPDX-License-Identifier: Apache-2.0

manifest:
  self:
    path: robofw

  remotes:
    - name: westonrobot-zephyr
      url-base: https://github.com/westonrobot

  projects:
    - name: zephyr
      remote: westonrobot-zephyr
      revision: rcu-zephyr-v2.7
      import: true
```
